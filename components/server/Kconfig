## components/server/Kconfig
```kconfig
menu "Server"

    config WEB_BASE_PATH
        string "Website base path"
        default "/storage/www"
        help
            Website base path.

endmenu
```

## components/settings_provider/Kconfig
```kconfig
menu "Settings Provider"

    config WIFI_SETTINGS_STORAGE
        string "WiFi settings storage"
        default "/storage/conf/wifi.json"
        help
            WiFi settings storage.

    config MODBUS_SETTINGS_STORAGE
        string "Modbus settings storage"
        default "/storage/conf/modbus.json"
        help
            Modbus settings storage.

endmenu
```
